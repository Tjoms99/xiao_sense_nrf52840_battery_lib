## CMakeLists.txt
```
# SPDX-License-Identifier: Apache-2.0

cmake_minimum_required(VERSION 3.20.0)
find_package(Zephyr REQUIRED HINTS $ENV{ZEPHYR_BASE})
project(peripheral)

target_sources(app PRIVATE
  src/main.c
  src/battery/battery.c
)
```

## prj.conf
```kconfig
#Peripherials 
CONFIG_GPIO=y
CONFIG_ADC=y

#USB / Termial
CONFIG_SERIAL=y
CONFIG_LOG=y
```

## boards/xiao_ble_nrf52840_sense.overlay
```dts
/ {
	xiao_ble_battery_dev: xiao_ble_battery_dev {
		compatible = "xiao-ble-battery";
		charging-enable-gpios = <&gpio0 17 GPIO_ACTIVE_LOW>;
		read-enable-gpios = <&gpio0 14 GPIO_ACTIVE_LOW>;
		charge-speed-gpios = <&gpio0 13 GPIO_ACTIVE_LOW>;
		adc-channel = <NRF_SAADC_AIN7>;
	};
};
```

## dts/bindings/xiao-ble-battery.yaml
```yaml
description: binding for XIAO BLE Battery Management Library

compatible: "xiao-ble-battery"

properties:
  charging-enable-gpios:
    type: phandle-array
    required: true
    description: |
      GPIO used to enable charging

  read-enable-gpios:
    type: phandle-array
    required: true
    description: GPIO used to enable the readout of the charging voltage

  charge-speed-gpios:
    type: phandle-array
    required: true
    description: GPIO used to select the charging speed (high = 100mA, low = 50mA)

  adc-input-id:
    type: int
    default: 7
    description: ADC channel id

  adc-gain:
    type: int
    default: 0
    description: ADC channel gain factor. ADC-reference * 6 = 3.6V

  adc-reference:
    type: int
    default: 4
    description: ADC reference. usually 0.6V.

  adc-channel:
    type: int
    required: true
    description: ADC channel to read out the battery voltage. Usually AIN7.

  adc-channel-id:
    type: int
    default: 7
    description: ADC channel to read out the battery voltage

  adc-resolution:
    type: int
    default: 12
    description: ADC resolution

  adc-sample-interval:
    type: int
    default: 500
    description: defines the time between each sample in [us].

  adc-total-samples:
    type: int
    default: 10
    description: |
      Change this to a higher number for better averages
      Note that increasing this holds up the thread / ADC for longer.

  adc-filtering-algorithm:
    type: string
    default: "average"
    description: ADC sample filtering algorithm
    enum:
      - "average"
      - "trimmed-mean"

  adc-acquisition-time:
      type: int
      default: 0
      description: ADC Acquisition time

  battery-callbacks-max:
      type: int
      default: 3
      description: |
        Defines the number of battery callbacks.
        Feel free to increas it if necessary.
```

## src/main.c
```c
/*
 * Copyright 2024 Marcus Alexander Tjomsaas
 *
 * Licensed under the Apache License, Version 2.0 (the "License");
 * you may not use this file except in compliance with the License.
 * You may obtain a copy of the License at
 *
 *     http://www.apache.org/licenses/LICENSE-2.0
 *
 * Unless required by applicable law or agreed to in writing, software
 * distributed under the License is distributed on an "AS IS" BASIS,
 * WITHOUT WARRANTIES OR CONDITIONS OF ANY KIND, either express or implied.
 * See the License for the specific language governing permissions and
 * limitations under the License.
 */

#include "battery/battery.h"

#include <stdint.h>
#include <zephyr/kernel.h>
#include <zephyr/logging/log.h>
LOG_MODULE_REGISTER(main, LOG_LEVEL_INF);

void log_battery_voltage(uint16_t millivolt)
{
	uint8_t battery_percentage = 0;

	int ret = battery_get_percentage(&battery_percentage, millivolt);
	if (ret)
	{
		LOG_ERR("Failed to calculate battery percentage");
		return;
	}

	LOG_INF("Battery at %d mV (capacity %d%%)", millivolt, battery_percentage);
}

void log_charging_state(bool is_charging)
{
	LOG_INF("Charger %s", is_charging ? "connected" : "disconnected");
}

int main(void)
{
	int ret = 0;
	k_msleep(1000); // Gives time for the terminal to connect to catch logs

	ret = battery_init();
	if (ret)
	{
		LOG_ERR("Failed to initialize battery management (error %d)", ret);
		return ret;
	}

	ret = battery_register_charging_callback(log_charging_state);
	if (ret)
	{
		LOG_ERR("Failed to register charging callback (error %d)", ret);
		return ret;
	}

	ret = battery_register_sample_callback(log_battery_voltage);
	if (ret)
	{
		LOG_ERR("Failed to register sample callback (error %d)", ret);
		return ret;
	}

	// Take a one-time sample
	battery_sample_once();
	k_sleep(K_SECONDS(3));

	// Start periodic sampling every 1000 ms
	battery_start_sampling(1000);

	while (1)
	{
		k_sleep(K_SECONDS(60));
		// You can stop periodic sampling if needed
		// battery_stop_sampling();
	}

	return 0;
}
```
